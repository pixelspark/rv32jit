## sdkconfig.defaults
```kconfig
# Rust often needs a bit of an extra main task stack size compared to C (the default is 3K)
CONFIG_ESP_MAIN_TASK_STACK_SIZE=7000

# Required to allow JIT
CONFIG_ESP_SYSTEM_MEMPROT_FEATURE=n
```
